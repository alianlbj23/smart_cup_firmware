## sdkconfig.defaults
```kconfig
# XIAO ESP32-C6 的 USB-C 接的是晶片內建的 USB Serial/JTAG，
# 把主控台（printf / ESP_LOG）直接導到這個埠，monitor 才看得到輸出。
CONFIG_ESP_CONSOLE_USB_SERIAL_JTAG=y

# XIAO ESP32-C6 板載 4MB Flash
CONFIG_ESPTOOLPY_FLASHSIZE_4MB=y

# BLE：只用 NimBLE（比 Bluedroid 小），一次只連一支手機
CONFIG_BT_ENABLED=y
CONFIG_BT_NIMBLE_ENABLED=y
CONFIG_BT_BLUEDROID_ENABLED=n
CONFIG_BT_NIMBLE_MAX_CONNECTIONS=1
# NimBLE 的 log 只留警告以上，避免打亂序列埠表格
CONFIG_BT_NIMBLE_LOG_LEVEL_WARNING=y

# 休眠（淺眠）：電源管理＋tickless idle，CPU 沒事做就自動淺眠，BLE 控制器在連線事件之間一起睡，
# 連線保持不斷。XIAO ESP32-C6 沒有外接 32 kHz 晶振，BLE 睡眠時脈用主晶振（依 ESP-IDF 範例
# examples/bluetooth/nimble/power_save 的 sdkconfig.40m.esp32c6）
CONFIG_PM_ENABLE=y
CONFIG_PM_POWER_DOWN_CPU_IN_LIGHT_SLEEP=y
CONFIG_FREERTOS_USE_TICKLESS_IDLE=y
CONFIG_BT_LE_SLEEP_ENABLE=y
CONFIG_BT_LE_LP_CLK_SRC_MAIN_XTAL=y
CONFIG_ESP_PHY_MAC_BB_PD=y
CONFIG_ESP_SLEEP_POWER_DOWN_FLASH=y
# 接著電腦 USB 時不自動淺眠，序列埠 monitor 才不會斷
CONFIG_USJ_NO_AUTO_LS_ON_CONNECTION=y
```
